/* tizix x86-ia16 : tick, time and process block/wake -- tzcc version of ../../src/kernel.c (x86 branch).
 * The kwork[] area itself and the 32-bit time_get()/time_set() live in tz/glue.s (tzcc has no 32-bit values).
 * kw.h is generated by Makefile.tz: offsets inside kwork[] (same formulas as src/kmem.h, x86-ia16 section). */
#include "kw.h"

char *tz_kwork(void);
unsigned tz_kw_w(unsigned off);
void tz_kw_setw(unsigned off, unsigned v);
void tz_irq_off(void);
void tz_irq_on(void);
void tz_park(void);
void tz_kyield(void);

/* timer interrupt (called from _isr08 with interrupts off) */
void plt_interrupt(void)
{
    char *kw;
    char sub;
    unsigned lo;

    kw = tz_kwork();
    tz_kw_setw(KW_TICKS_O, tz_kw_w(KW_TICKS_O) + 1);     /* raw 100Hz tick for delays */
    sub = kw[KW_SUB_O] + 1;
    kw[KW_SUB_O] = sub;
    if (sub >= TICK_HZ) {
        kw[KW_SUB_O] = 0;
        lo = tz_kw_w(KW_EPOCH_O) + 1;                    /* 32-bit epoch seconds: low word, carry into the high word */
        tz_kw_setw(KW_EPOCH_O, lo);
        if (lo == 0)
            tz_kw_setw(KW_EPOCH_O + 2, tz_kw_w(KW_EPOCH_O + 2) + 1);
    }
}

void kernel_init(void)
{
    char *kw;

    kw = tz_kwork();
    tz_kw_setw(KW_TICKS_O, 0);
    tz_kw_setw(KW_EPOCH_O, 0);
    tz_kw_setw(KW_EPOCH_O + 2, 0);
    kw[KW_SUB_O] = 0;
    tz_irq_on();                        /* PIT / INT 08h / PIC are set up by crt0.s; open interrupts here */
}

/* park the calling slot until proc_wake; a wake that came first is remembered in wakepend */
void proc_block(void)
{
    char *kw;
    char me;

    kw = tz_kwork();
    me = kw[KW_CUR_O];
    tz_irq_off();
    if (kw[KW_WAKE_O + me]) {
        kw[KW_WAKE_O + me] = 0;
        tz_irq_on();
        return;
    }
    kw[KW_BLK_O + me] = 1;
    tz_irq_on();
    while (kw[KW_BLK_O + me])
        tz_park();
}

void proc_wake(char block)             /* gcc pushes the unsigned char argument without extending it */
{
    char *kw;

    if (block > PROC_BLOCK_MAX)
        return;
    kw = tz_kwork();
    tz_irq_off();
    if (kw[KW_BLK_O + block])
        kw[KW_BLK_O + block] = 0;
    else
        kw[KW_WAKE_O + block] = 1;
    tz_irq_on();
}

/* ticks / TICK_HZ without a signed overflow: halve first, then divide */
unsigned uptime_sec(void)
{
    return (tz_kw_w(KW_TICKS_O) >> 1) / (TICK_HZ / 2);
}

unsigned getticks(void)
{
    tz_kyield();
    return tz_kw_w(KW_TICKS_O);
}
